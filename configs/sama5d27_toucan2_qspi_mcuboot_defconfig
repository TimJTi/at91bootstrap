## configs/sama5d27_toucan2_qspi_mcuboot_defconfig
```kconfig
# Copyright (C) 2006 Microchip Technology Inc. and its subsidiaries
#
# SPDX-License-Identifier: MIT

CONFIG_SAMA5D2=y
CONFIG_CRYSTAL_24_000MHZ=y
CONFIG_DEBUG=y
CONFIG_DDR_SET_BY_DEVICE=y
CONFIG_DDR_W971GG6SB_D2=y
CONFIG_SPI_CLK=66000000
CONFIG_QSPI=y
CONFIG_QSPI_BUS=0
CONFIG_QSPI_IOSET=1
CONFIG_IMG_ADDRESS="0x00008000"
CONFIG_JUMP_ADDR="0x23f00000"
# CONFIG_ENTER_NWD is not set
CONFIG_BOARD_QUIRK_SAMA5D2_SIP=y
CONFIG_QSPI_4B_OPCODES=y
CONFIG_HW_BANNER="\"\\n\\nJTi AT91Bootstrap \" AT91BOOTSTRAP_VERSION \" (\" COMPILE_TIME \")\\n\\n\""
```

## contrib/board/jtinnovations/sama5d27_t2/sama5d27_t2_defconfig
```kconfig
CONFIG_SAMA5D27_T2=y
CONFIG_RAM_64MB=y
CONFIG_SPI_CLK=66000000
CONFIG_QSPI=y
CONFIG_IMG_ADDRESS="0x8000"
CONFIG_JUMP_ADDR="0x23f00000"
# CONFIG_ENTER_NWD is not set
```
