## defconfig
```kconfig
CONFIG_CRYSTAL_24_000MHZ=y
CONFIG_DEBUG=y
CONFIG_HW_BANNER="\"\\n\\nJTi AT91Bootstrap \" AT91BOOTSTRAP_VERSION \" (\" COMPILE_TIME \")\\n\\n\""
CONFIG_DDR_SET_BY_DEVICE=y
CONFIG_DDR_W971GG6SB_D2=y
CONFIG_MMU=y
CONFIG_CACHES=y
CONFIG_SPI_CLK=66000000
CONFIG_QSPI=y
CONFIG_QSPI_4B_OPCODES=y
CONFIG_JUMP_ADDR="0x23f00000"
CONFIG_BOARD_QUIRK_SAMA5D2_SIP=y
```
